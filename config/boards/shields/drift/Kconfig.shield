## config/boards/shields/drift/Kconfig.shield
```kconfig
# Copyright (c) 2020 Ryan Cross
# SPDX-License-Identifier: MIT

config SHIELD_drift_LEFT
    def_bool $(shields_list_contains,drift_left)

config SHIELD_drift_RIGHT
    def_bool $(shields_list_contains,drift_right)
```
